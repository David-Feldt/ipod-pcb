## firmware/remote/main/Kconfig.projbuild
```kconfig
menu "E-ink Remote"

config REMOTE_SPOTIFY_CLIENT_ID
    string "Spotify app client ID"
    default "fb6818b0834e4e418b6ad5ef191383ee"
    help
        Client ID of your Spotify developer app (not a secret; PKCE has no client secret).

config REMOTE_PAIRING_REDIRECT_URI
    string "Spotify redirect URI (static bounce page)"
    default "https://david-feldt.github.io/eink-remote-pair/"
    help
        HTTPS URL of pairing/index.html (GitHub Pages, repo David-Feldt/eink-remote-pair),
        exactly as registered in the Spotify app. Empty: http://127.0.0.1:8888/callback
        with tools/pairing_bounce.py (browser on the same computer only).

config REMOTE_LOW_BATT_MV
    int "Low-battery shutdown threshold (mV) - PROVISIONAL"
    default 3450
    help
        Not an approved value (FIRMWARE-NOTES.md). Choose from pack data and measured sag.
        On battery, this many mV for ~10 s puts the board into deep sleep.

config REMOTE_LOW_BATT_HYST_MV
    int "Low-battery wake hysteresis (mV)"
    default 150
    range 0 500
    help
        After a low-battery sleep, a button wake without USB resumes only if the
        battery reads at least the threshold plus this much; otherwise it sleeps again.

config REMOTE_FULL_REFRESH_EVERY
    int "Full e-paper clearing refresh after N partial updates"
    default 5
    range 1 100

config REMOTE_PROGRESS_INTERVAL_S
    int "Progress bar update interval (s)"
    default 10
    range 1 120

endmenu
```
